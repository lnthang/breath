## components/MQTTClient/Kconfig
```kconfig
menu "MQTT Client"

config MQTT_MAX_CLIENT
  int "Maximum number of supported Clients"
  default 5
  help
    Max number of Client concurrently connected to Server

config MQTT_MAX_SUB_TOPIC_PER_CLIENT
  int "Maximum number of Subscribed Topics per Client"
  default 5
  help
    Max number of SubTopic at a time for each Client

endmenu
```

## main/Kconfig.projbuild
```kconfig
menu "Breath Project Configuration"

menu "WIFI Connection Credentials"

config WIFI_SSID
  string "Wifi SSID"
  default "networkSSID"
  help
    SSID (network name) of network to which device connect.

config WIFI_PASSWORD
  string "Wifi Password"
  default "password"
  help
    Wifi password (supports WPA or WPA2 only) of network to which device connect.

    Can be left empty if the network has no security set.
endmenu

endmenu
```
